## Kconfig
```kconfig
# SPDX-FileCopyrightText: 2026 roolrz
# SPDX-License-Identifier: Apache-2.0

config SYSTEM_APP_COMPONENTCTL
    bool "componentctl (/bin/componentctl)"
    default y
    depends on SYSTEM_APP_COMPONENT_MANAGER
    help
        Build and deploy hyper-componentctl at /bin/componentctl.
```
